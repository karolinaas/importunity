## CMakeLists.txt
```
# Copyright 2024 NXP
# SPDX-License-Identifier: Apache-2.0

cmake_minimum_required(VERSION 3.20.0)
find_package(Zephyr REQUIRED HINTS $ENV{ZEPHYR_BASE})
project(test_unity)

if(TEST_UNITY_ARRAYS)
    zephyr_compile_definitions(TEST_UNITY_ARRAYS)

elseif(TEST_UNITY_CORE)
    zephyr_compile_definitions(TEST_UNITY_CORE)

elseif(TEST_UNITY_DOUBLES)
    zephyr_compile_definitions(TEST_UNITY_DOUBLES)

elseif(TEST_UNITY_FLOATS)
    zephyr_compile_definitions(TEST_UNITY_FLOATS)

elseif(TEST_UNITY_INTEGERS)
    zephyr_compile_definitions(TEST_UNITY_INTEGERS)

elseif(TEST_UNITY_INTEGERS_64)
    zephyr_compile_definitions(TEST_UNITY_INTEGERS_64)

elseif(TEST_UNITY_MEMORY)
    zephyr_compile_definitions(TEST_UNITY_MEMORY)

elseif(TEST_UNITY_PARAMETERIZED)
    zephyr_compile_definitions(TEST_UNITY_PARAMETERIZED)

elseif(TEST_UNITY_PARAMETERIZEDDEMO)
    zephyr_compile_definitions(TEST_UNITY_PARAMETERIZEDDEMO)

elseif(TEST_UNITY_STRINGS)
    zephyr_compile_definitions(TEST_UNITY_STRINGS)
    
endif()

zephyr_include_directories(${CMAKE_CURRENT_LIST_DIR}/../../unity/test/tests)

FILE(GLOB app_sources src/*.c)
target_sources(app PRIVATE ${app_sources})
```

## prj.conf
```kconfig
CONFIG_UNITY_TEST=y
```

## src/main.c
```c
/*
 * Copyright 2024 NXP
 *
 * SPDX-License-Identifier: Apache-2.0
 */

#include "unity.h"
#include "run_test_unity.h"

int main(void)
{
    UNITY_BEGIN();

#ifdef TEST_UNITY_ARRAYS
    run_test_unity_arrays();
#elif TEST_UNITY_CORE
    run_test_unity_core();
#elif TEST_UNITY_DOUBLES
    run_test_unity_doubles();
#elif TEST_UNITY_FLOATS
    run_test_unity_floats();
#elif TEST_UNITY_INTEGERS
    run_test_unity_integers();
#elif TEST_UNITY_INTEGERS_64
    run_test_unity_integers_64();
#elif TEST_UNITY_MEMORY
    run_test_unity_memory();
#elif TEST_UNITY_PARAMETERIZED
    run_test_unity_parameterized();
#elif TEST_UNITY_PARAMETERIZEDDEMO
    run_test_unity_parameterizedDemo();
#elif TEST_UNITY_STRINGS
    run_test_unity_strings();
#endif

    return UNITY_END();
}
```

## src/run_test.c
```c
/*
 * Copyright 2024 NXP
 *
 * SPDX-License-Identifier: Apache-2.0
 */

#include "run_test.h"
#include "test_unity_arrays.c"
// #include "test_unity_core.c"
// #include "test_unity_doubles.c"
// #include "test_unity_floats.c"
// #include "test_unity_integers.c"
// #include "test_unity_integers_64.c"
// #include "test_unity_memory.c"
// #include "test_unity_parameterized.c"
// #include "test_unity_parameterizedDemo.c"
// #include "test_unity_strings.c"


void run_test_unity_arrays(void) {
    RUN_TEST(testInt64ArrayWithinDelta);
    RUN_TEST(testInt64ArrayWithinDeltaAndMessage);
    RUN_TEST(testInt64ArrayNotWithinDelta);
}

// void run_test_unity_core(void) {
//     RUN_TEST(testUnitySizeInitializationReminder);
// }

// void run_test_unity_doubles(void) {
//     RUN_TEST(testDoublesWithinDelta);
// }

// void run_test_unity_floats(void) {
//     RUN_TEST(testFloatsWithinDelta);
// }

// void run_test_unity_integers(void) {
//     RUN_TEST(testNotEqualInts);
// }

// void run_test_unity_integers_64(void) {
//     RUN_TEST(testInt64ArrayWithinDeltaSamePointer);
// }

// void run_test_unity_memory(void) {
//     RUN_TEST(testEqualMemory);
// }

// void run_test_unity_parameterized(void) {
//     RUN_TEST(test_TheseShouldAllPass);
// }

// void run_test_unity_parameterizedDemo(void) {
//     RUN_TEST(test_demoParamFunction);
// }

// void run_test_unity_strings(void) {
//     RUN_TEST(testEqualStrings);
// }
```

## src/run_test_memory.c
```c
/*
 * Copyright 2024 NXP
 *
 * SPDX-License-Identifier: Apache-2.0
 */

#ifdef TEST_UNITY_MEMORY

#include "run_test_unity.h"
#include "test_unity_memory.c"

void run_test_unity_memory(void)
{
    RUN_TEST(testEqualMemory);
    RUN_TEST(testNotEqualMemory1);
    RUN_TEST(testNotEqualMemory2);
    RUN_TEST(testNotEqualMemory3);
    RUN_TEST(testNotEqualMemory4);
    RUN_TEST(testNotEqualMemoryLengthZero);
}

#endif
```

## src/run_test_unity.h
```c
/*
 * Copyright 2024 NXP
 *
 * SPDX-License-Identifier: Apache-2.0
 */

void run_test_unity_arrays(void);
void run_test_unity_core(void);
void run_test_unity_doubles(void);
void run_test_unity_floats(void);
void run_test_unity_integers(void);
void run_test_unity_integers_64(void);
void run_test_unity_memory(void);
void run_test_unity_parameterized(void);
void run_test_unity_parameterizedDemo(void);
void run_test_unity_strings(void);
```

## src/run_test_unity_arrays.c
```c
/*
 * Copyright 2024 NXP
 *
 * SPDX-License-Identifier: Apache-2.0
 */

#ifdef TEST_UNITY_ARRAYS

#include "run_test_unity.h"
#include "test_unity_arrays.c"

void run_test_unity_arrays(void)
{
    RUN_TEST(testInt64ArrayWithinDelta);
    RUN_TEST(testInt64ArrayWithinDeltaAndMessage);
    RUN_TEST(testInt64ArrayNotWithinDelta);
    RUN_TEST(testInt64ArrayNotWithinDeltaAndMessage);
    RUN_TEST(testInt64ArrayWithinDeltaPointless);
    RUN_TEST(testInt64ArrayWithinDeltaPointlessAndMessage);
    RUN_TEST(testInt64ArrayWithinDeltaExpectedNull);
    RUN_TEST(testInt64ArrayWithinDeltaExpectedNullAndMessage);
    RUN_TEST(testInt64ArrayWithinDeltaActualNull);
    RUN_TEST(testInt64ArrayWithinDeltaActualNullAndMessage);
    RUN_TEST(testInt64ArrayWithinDeltaSamePointer);
    RUN_TEST(testInt64ArrayWithinDeltaSamePointerAndMessage);
    RUN_TEST(testIntArrayWithinDelta);
    RUN_TEST(testIntArrayWithinDeltaAndMessage);
    RUN_TEST(testIntArrayNotWithinDelta);
    RUN_TEST(testIntArrayNotWithinDeltaAndMessage);
    RUN_TEST(testIntArrayWithinDeltaPointless);
    RUN_TEST(testIntArrayWithinDeltaPointlessAndMessage);
    RUN_TEST(testIntArrayWithinDeltaExpectedNull);
    RUN_TEST(testIntArrayWithinDeltaExpectedNullAndMessage);
    RUN_TEST(testIntArrayWithinDeltaActualNull);
    RUN_TEST(testIntArrayWithinDeltaActualNullAndMessage);
    RUN_TEST(testIntArrayWithinDeltaSamePointer);
    RUN_TEST(testIntArrayWithinDeltaSamePointerAndMessage);
    RUN_TEST(testInt16ArrayWithinDelta);
    RUN_TEST(testInt16ArrayWithinDeltaAndMessage);
    RUN_TEST(testInt16ArrayNotWithinDelta);
    RUN_TEST(testInt16ArrayNotWithinDeltaAndMessage);
    RUN_TEST(testInt16ArrayWithinDeltaPointless);
    RUN_TEST(testInt16ArrayWithinDeltaPointlessAndMessage);
    RUN_TEST(testInt16ArrayWithinDeltaExpectedNull);
    RUN_TEST(testInt16ArrayWithinDeltaExpectedNullAndMessage);
    RUN_TEST(testInt16ArrayWithinDeltaActualNull);
    RUN_TEST(testInt16ArrayWithinDeltaActualNullAndMessage);
    RUN_TEST(testInt16ArrayWithinDeltaSamePointer);
    RUN_TEST(testInt16ArrayWithinDeltaSamePointerAndMessage);
    RUN_TEST(testInt8ArrayWithinDelta);
    RUN_TEST(testInt8ArrayWithinDeltaAndMessage);
    RUN_TEST(testInt8ArrayNotWithinDelta);
    RUN_TEST(testInt8ArrayNotWithinDeltaAndMessage);
    RUN_TEST(testInt8ArrayWithinDeltaPointless);
    RUN_TEST(testInt8ArrayWithinDeltaPointlessAndMessage);
    RUN_TEST(testInt8ArrayWithinDeltaExpectedNull);
    RUN_TEST(testInt8ArrayWithinDeltaExpectedNullAndMessage);
    RUN_TEST(testInt8ArrayWithinDeltaActualNull);
    RUN_TEST(testInt8ArrayWithinDeltaActualNullAndMessage);
    RUN_TEST(testInt8ArrayWithinDeltaSamePointer);
    RUN_TEST(testInt8ArrayWithinDeltaSamePointerAndMessage);
    RUN_TEST(testCHARArrayWithinDelta);
    RUN_TEST(testCHARArrayWithinDeltaAndMessage);
    RUN_TEST(testCHARArrayNotWithinDelta);
    RUN_TEST(testCHARArrayNotWithinDeltaAndMessage);
    RUN_TEST(testCHARArrayWithinDeltaPointless);
    RUN_TEST(testCHARArrayWithinDeltaPointlessAndMessage);
    RUN_TEST(testCHARArrayWithinDeltaExpectedNull);
    RUN_TEST(testCHARArrayWithinDeltaExpectedNullAndMessage);
    RUN_TEST(testCHARArrayWithinDeltaActualNull);
    RUN_TEST(testCHARArrayWithinDeltaActualNullAndMessage);
    RUN_TEST(testCHARArrayWithinDeltaSamePointer);
    RUN_TEST(testCHARArrayWithinDeltaSamePointerAndMessage);
    RUN_TEST(testUInt64ArrayWithinDelta);
    RUN_TEST(testUInt64ArrayWithinDeltaAndMessage);
    RUN_TEST(testUInt64ArrayNotWithinDelta);
    RUN_TEST(testUInt64ArrayNotWithinDeltaAndMessage);
    RUN_TEST(testUInt64ArrayWithinDeltaPointless);
    RUN_TEST(testUInt64ArrayWithinDeltaPointlessAndMessage);
    RUN_TEST(testUInt64ArrayWithinDeltaExpectedNull);
    RUN_TEST(testUInt64ArrayWithinDeltaExpectedNullAndMessage);
    RUN_TEST(testUInt64ArrayWithinDeltaActualNull);
    RUN_TEST(testUInt64ArrayWithinDeltaActualNullAndMessage);
    RUN_TEST(testUInt64ArrayWithinDeltaSamePointer);
    RUN_TEST(testUInt64ArrayWithinDeltaSamePointerAndMessage);
    RUN_TEST(testUIntArrayWithinDelta);
    RUN_TEST(testUIntArrayWithinDeltaAndMessage);
    RUN_TEST(testUIntArrayNotWithinDelta);
    RUN_TEST(testUIntArrayNotWithinDeltaAndMessage);
    RUN_TEST(testUIntArrayWithinDeltaPointless);
    RUN_TEST(testUIntArrayWithinDeltaPointlessAndMessage);
    RUN_TEST(testUIntArrayWithinDeltaExpectedNull);
    RUN_TEST(testUIntArrayWithinDeltaExpectedNullAndMessage);
    RUN_TEST(testUIntArrayWithinDeltaActualNull);
    RUN_TEST(testUIntArrayWithinDeltaActualNullAndMessage);
    RUN_TEST(testUIntArrayWithinDeltaSamePointer);
    RUN_TEST(testUIntArrayWithinDeltaSamePointerAndMessage);
    RUN_TEST(testUInt16ArrayWithinDelta);
    RUN_TEST(testUInt16ArrayWithinDeltaAndMessage);
    RUN_TEST(testUInt16ArrayNotWithinDelta);
    RUN_TEST(testUInt16ArrayNotWithinDeltaAndMessage);
    RUN_TEST(testUInt16ArrayWithinDeltaPointless);
    RUN_TEST(testUInt16ArrayWithinDeltaPointlessAndMessage);
    RUN_TEST(testUInt16ArrayWithinDeltaExpectedNull);
    RUN_TEST(testUInt16ArrayWithinDeltaExpectedNullAndMessage);
    RUN_TEST(testUInt16ArrayWithinDeltaActualNull);
    RUN_TEST(testUInt16ArrayWithinDeltaActualNullAndMessage);
    RUN_TEST(testUInt16ArrayWithinDeltaSamePointer);
    RUN_TEST(testUInt16ArrayWithinDeltaSamePointerAndMessage);
    RUN_TEST(testUInt8ArrayWithinDelta);
    RUN_TEST(testUInt8ArrayWithinDeltaAndMessage);
    RUN_TEST(testUInt8ArrayNotWithinDelta);
    RUN_TEST(testUInt8ArrayNotWithinDeltaAndMessage);
    RUN_TEST(testUInt8ArrayWithinDeltaPointless);
    RUN_TEST(testUInt8ArrayWithinDeltaPointlessAndMessage);
    RUN_TEST(testUInt8ArrayWithinDeltaExpectedNull);
    RUN_TEST(testUInt8ArrayWithinDeltaExpectedNullAndMessage);
    RUN_TEST(testUInt8ArrayWithinDeltaActualNull);
    RUN_TEST(testUInt8ArrayWithinDeltaActualNullAndMessage);
    RUN_TEST(testUInt8ArrayWithinDeltaSamePointer);
    RUN_TEST(testUInt8ArrayWithinDeltaSamePointerAndMessage);
    RUN_TEST(testHEX64ArrayWithinDelta);
    RUN_TEST(testHEX64ArrayWithinDeltaShouldNotHaveSignIssues);
    RUN_TEST(testHEX64ArrayWithinDeltaAndMessage);
    RUN_TEST(testHEX64ArrayNotWithinDelta);
    RUN_TEST(testHEX64ArrayNotWithinDeltaAndMessage);
    RUN_TEST(testHEX64ArrayWithinDeltaPointless);
    RUN_TEST(testHEX64ArrayWithinDeltaPointlessAndMessage);
    RUN_TEST(testHEX64ArrayWithinDeltaExpectedNull);
    RUN_TEST(testHEX64ArrayWithinDeltaExpectedNullAndMessage);
    RUN_TEST(testHEX64ArrayWithinDeltaActualNull);
    RUN_TEST(testHEX64ArrayWithinDeltaActualNullAndMessage);
    RUN_TEST(testHEX64ArrayWithinDeltaSamePointer);
    RUN_TEST(testHEX64ArrayWithinDeltaSamePointerAndMessage);
    RUN_TEST(testHEX32ArrayWithinDelta);
    RUN_TEST(testHEX32ArrayWithinDeltaShouldNotHaveSignIssues);
    RUN_TEST(testHEX32ArrayWithinDeltaAndMessage);
    RUN_TEST(testHEX32ArrayNotWithinDelta);
    RUN_TEST(testHEX32ArrayNotWithinDeltaAndMessage);
    RUN_TEST(testHEX32ArrayWithinDeltaPointless);
    RUN_TEST(testHEX32ArrayWithinDeltaPointlessAndMessage);
    RUN_TEST(testHEX32ArrayWithinDeltaExpectedNull);
    RUN_TEST(testHEX32ArrayWithinDeltaExpectedNullAndMessage);
    RUN_TEST(testHEX32ArrayWithinDeltaActualNull);
    RUN_TEST(testHEX32ArrayWithinDeltaActualNullAndMessage);
    RUN_TEST(testHEX32ArrayWithinDeltaSamePointer);
    RUN_TEST(testHEX32ArrayWithinDeltaSamePointerAndMessage);
    RUN_TEST(testHEX16ArrayWithinDelta);
    RUN_TEST(testHEX16ArrayWithinDeltaShouldNotHaveSignIssues);
    RUN_TEST(testHEX16ArrayWithinDeltaAndMessage);
    RUN_TEST(testHEX16ArrayNotWithinDelta);
    RUN_TEST(testHEX16ArrayNotWithinDeltaAndMessage);
    RUN_TEST(testHEX16ArrayWithinDeltaPointless);
    RUN_TEST(testHEX16ArrayWithinDeltaPointlessAndMessage);
    RUN_TEST(testHEX16ArrayWithinDeltaExpectedNull);
    RUN_TEST(testHEX16ArrayWithinDeltaExpectedNullAndMessage);
    RUN_TEST(testHEX16ArrayWithinDeltaActualNull);
    RUN_TEST(testHEX16ArrayWithinDeltaActualNullAndMessage);
    RUN_TEST(testHEX16ArrayWithinDeltaSamePointer);
    RUN_TEST(testHEX16ArrayWithinDeltaSamePointerAndMessage);
    RUN_TEST(testHEX8ArrayWithinDelta);
    RUN_TEST(testHEX8ArrayWithinDeltaAndMessage);
    RUN_TEST(testHEX8ArrayNotWithinDelta);
    RUN_TEST(testHEX8ArrayWithinDeltaShouldNotHaveSignIssues);
    RUN_TEST(testHEX8ArrayNotWithinDeltaAndMessage);
    RUN_TEST(testHEX8ArrayWithinDeltaPointless);
    RUN_TEST(testHEX8ArrayWithinDeltaPointlessAndMessage);
    RUN_TEST(testHEX8ArrayWithinDeltaExpectedNull);
    RUN_TEST(testHEX8ArrayWithinDeltaExpectedNullAndMessage);
    RUN_TEST(testHEX8ArrayWithinDeltaActualNull);
    RUN_TEST(testHEX8ArrayWithinDeltaActualNullAndMessage);
    RUN_TEST(testHEX8ArrayWithinDeltaSamePointer);
    RUN_TEST(testHEX8ArrayWithinDeltaSamePointerAndMessage);
    RUN_TEST(testEqualIntArrays);
    RUN_TEST(testNotEqualIntArraysNullExpected);
    RUN_TEST(testNotEqualIntArraysNullActual);
    RUN_TEST(testNotEqualIntArrays1);
    RUN_TEST(testNotEqualIntArrays2);
    RUN_TEST(testNotEqualIntArrays3);
    RUN_TEST(testNotEqualIntArraysLengthZero);
    RUN_TEST(testEqualIntEachEqual);
    RUN_TEST(testNotEqualIntEachEqualNullActual);
    RUN_TEST(testNotEqualIntEachEqual1);
    RUN_TEST(testNotEqualIntEachEqual2);
    RUN_TEST(testNotEqualIntEachEqual3);
    RUN_TEST(testNotEqualEachEqualLengthZero);
    RUN_TEST(testEqualPtrArrays);
    RUN_TEST(testNotEqualPtrArraysNullExpected);
    RUN_TEST(testNotEqualPtrArraysNullActual);
    RUN_TEST(testNotEqualPtrArrays1);
    RUN_TEST(testNotEqualPtrArrays2);
    RUN_TEST(testNotEqualPtrArrays3);
    RUN_TEST(testEqualPtrEachEqual);
    RUN_TEST(testNotEqualPtrEachEqualNullExpected);
    RUN_TEST(testNotEqualPtrEachEqualNullActual);
    RUN_TEST(testNotEqualPtrEachEqual1);
    RUN_TEST(testNotEqualPtrEachEqual2);
    RUN_TEST(testNotEqualPtrEachEqual3);
    RUN_TEST(testEqualInt8Arrays);
    RUN_TEST(testNotEqualInt8Arrays);
    RUN_TEST(testEqualInt8EachEqual);
    RUN_TEST(testNotEqualInt8EachEqual);
    RUN_TEST(testEqualCHARArrays);
    RUN_TEST(testNotEqualCHARArrays);
    RUN_TEST(testEqualCHAREachEqual);
    RUN_TEST(testNotEqualCHAREachEqual);
    RUN_TEST(testEqualUIntArrays);
    RUN_TEST(testNotEqualUIntArrays1);
    RUN_TEST(testNotEqualUIntArrays2);
    RUN_TEST(testNotEqualUIntArrays3);
    RUN_TEST(testEqualUIntEachEqual);
    RUN_TEST(testNotEqualUIntEachEqual1);
    RUN_TEST(testNotEqualUIntEachEqual2);
    RUN_TEST(testNotEqualUIntEachEqual3);
    RUN_TEST(testEqualInt16Arrays);
    RUN_TEST(testNotEqualInt16Arrays);
    RUN_TEST(testEqualInt16EachEqual);
    RUN_TEST(testNotEqualInt16EachEqual);
    RUN_TEST(testEqualInt32Arrays);
    RUN_TEST(testNotEqualInt32Arrays);
    RUN_TEST(testEqualInt32EachEqual);
    RUN_TEST(testNotEqualInt32EachEqual);
    RUN_TEST(testEqualUINT8Arrays);
    RUN_TEST(testNotEqualUINT8Arrays1);
    RUN_TEST(testNotEqualUINT8Arrays2);
    RUN_TEST(testNotEqualUINT8Arrays3);
    RUN_TEST(testEqualUINT16Arrays);
    RUN_TEST(testNotEqualUINT16Arrays1);
    RUN_TEST(testNotEqualUINT16Arrays2);
    RUN_TEST(testNotEqualUINT16Arrays3);
    RUN_TEST(testEqualUINT32Arrays);
    RUN_TEST(testNotEqualUINT32Arrays1);
    RUN_TEST(testNotEqualUINT32Arrays2);
    RUN_TEST(testNotEqualUINT32Arrays3);
    RUN_TEST(testEqualHEXArrays);
    RUN_TEST(testNotEqualHEXArrays1);
    RUN_TEST(testNotEqualHEXArrays2);
    RUN_TEST(testNotEqualHEXArrays3);
    RUN_TEST(testEqualHEX32Arrays);
    RUN_TEST(testNotEqualHEX32Arrays1);
    RUN_TEST(testNotEqualHEX32Arrays2);
    RUN_TEST(testNotEqualHEX32Arrays3);
    RUN_TEST(testEqualHEX16Arrays);
    RUN_TEST(testNotEqualHEX16Arrays1);
    RUN_TEST(testNotEqualHEX16Arrays2);
    RUN_TEST(testNotEqualHEX16Arrays3);
    RUN_TEST(testEqualHEX8Arrays);
    RUN_TEST(testNotEqualHEX8Arrays1);
    RUN_TEST(testNotEqualHEX8Arrays2);
    RUN_TEST(testNotEqualHEX8Arrays3);
    RUN_TEST(testEqualUINT8EachEqual);
    RUN_TEST(testNotEqualUINT8EachEqual1);
    RUN_TEST(testNotEqualUINT8EachEqual2);
    RUN_TEST(testNotEqualUINT8EachEqual3);
    RUN_TEST(testEqualUINT16EachEqual);
    RUN_TEST(testNotEqualUINT16EachEqual1);
    RUN_TEST(testNotEqualUINT16EachEqual2);
    RUN_TEST(testNotEqualUINT16EachEqual3);
    RUN_TEST(testEqualUINT32EachEqual);
    RUN_TEST(testNotEqualUINT32EachEqual1);
    RUN_TEST(testNotEqualUINT32EachEqual2);
    RUN_TEST(testNotEqualUINT32EachEqual3);
    RUN_TEST(testEqualHEXEachEqual);
    RUN_TEST(testNotEqualHEXEachEqual1);
    RUN_TEST(testNotEqualHEXEachEqual2);
    RUN_TEST(testNotEqualHEXEachEqual3);
    RUN_TEST(testEqualHEX32EachEqual);
    RUN_TEST(testNotEqualHEX32EachEqual1);
    RUN_TEST(testNotEqualHEX32EachEqual2);
    RUN_TEST(testNotEqualHEX32EachEqual3);
    RUN_TEST(testEqualHEX16EachEqual);
    RUN_TEST(testNotEqualHEX16EachEqual1);
    RUN_TEST(testNotEqualHEX16EachEqual2);
    RUN_TEST(testNotEqualHEX16EachEqual3);
    RUN_TEST(testEqualHEX8EachEqual);
    RUN_TEST(testNotEqualHEX8EachEqual1);
    RUN_TEST(testNotEqualHEX8EachEqual2);
    RUN_TEST(testNotEqualHEX8EachEqual3);
    RUN_TEST(testEqualHEX64Arrays);
    RUN_TEST(testEqualUint64Arrays);
    RUN_TEST(testEqualInt64Arrays);
    RUN_TEST(testNotEqualHEX64Arrays1);
    RUN_TEST(testNotEqualHEX64Arrays2);
    RUN_TEST(testNotEqualUint64Arrays);
    RUN_TEST(testNotEqualInt64Arrays);
    RUN_TEST(testVerifyIntPassingPointerComparisonOnZeroLengthArray);
    RUN_TEST(testVerifyIntFailingPointerComparisonOnZeroLengthArray);
}

#endif
```

## src/run_test_unity_arrays.h
```c
/*
 * Copyright 2024 NXP
 *
 * SPDX-License-Identifier: Apache-2.0
 */

void run_test_unity_arrays(void);

// void run_test_unity_doubles(void);
// void run_test_unity_floats(void);
// void run_test_unity_integers(void);
// void run_test_unity_integers_64(void);
// void run_test_unity_memory(void);
// void run_test_unity_parameterized(void);
// void run_test_unity_parameterizedDemo(void);
// void run_test_unity_strings(void);
```

## src/run_test_unity_core.c
```c
/*
 * Copyright 2024 NXP
 *
 * SPDX-License-Identifier: Apache-2.0
 */

#ifdef TEST_UNITY_CORE

#include "run_test_unity.h"
#include "test_unity_core.c"

void run_test_unity_core(void)
{
    RUN_TEST(testUnitySizeInitializationReminder);
    RUN_TEST(testPassShouldEndImmediatelyWithPass);
    RUN_TEST(testPassShouldEndImmediatelyWithPassAndMessage);
    RUN_TEST(testMessageShouldDisplayMessageWithoutEndingAndGoOnToPass);
    RUN_TEST(testMessageShouldDisplayMessageWithoutEndingAndGoOnToFail);
    RUN_TEST(testTrue);
    RUN_TEST(testFalse);
    RUN_TEST(testSingleStatement);
    RUN_TEST(testPreviousPass);
    RUN_TEST(testNotVanilla);
    RUN_TEST(testNotTrue);
    RUN_TEST(testNotFalse);
    RUN_TEST(testNotUnless);
    RUN_TEST(testNotNotEqual);
    RUN_TEST(testFail);
    RUN_TEST(testIsNull);
    RUN_TEST(testIsNullShouldFailIfNot);
    RUN_TEST(testNotNullShouldFailIfNULL);
    RUN_TEST(testIsEmpty);
    RUN_TEST(testIsEmptyShouldFailIfNot);
    RUN_TEST(testNotEmptyShouldFailIfEmpty);
    RUN_TEST(testIgnore);
    RUN_TEST(testIgnoreMessage);
    RUN_TEST(testProtection);
    RUN_TEST(testIgnoredAndThenFailInTearDown);
    RUN_TEST(testFailureCountIncrementsAndIsReturnedAtEnd);
    RUN_TEST(testThatDetailsCanBeHandleOneDetail);
    RUN_TEST(testThatDetailsCanHandleTestFail);
    RUN_TEST(testThatDetailsCanBeHandleTwoDetails);
    RUN_TEST(testThatDetailsCanBeHandleSingleDetailClearingTwoDetails);
}

#endif
```

## src/run_test_unity_doubles.c
```c
/*
 * Copyright 2024 NXP
 *
 * SPDX-License-Identifier: Apache-2.0
 */

#ifdef TEST_UNITY_DOUBLES

#include "run_test_unity.h"
#include "test_unity_doubles.c"

void run_test_unity_doubles(void)
{
    RUN_TEST(testDoublesWithinDelta);
    RUN_TEST(testDoublesNotWithinDelta);
    RUN_TEST(testDoublesEqual);
    RUN_TEST(testDoublesNotEqual);
    RUN_TEST(testDoublesNotEqualNegative1);
    RUN_TEST(testDoublesNotEqualNegative2);
    RUN_TEST(testDoublesNotEqualActualNaN);
    RUN_TEST(testDoublesNotEqualExpectedNaN);
    RUN_TEST(testDoublesEqualBothNaN);
    RUN_TEST(testDoublesNotEqualInfNaN);
    RUN_TEST(testDoublesNotEqualNaNInf);
    RUN_TEST(testDoublesNotEqualActualInf);
    RUN_TEST(testDoublesNotEqualExpectedInf);
    RUN_TEST(testDoublesEqualBothInf);
    RUN_TEST(testDoublesNotEqualPlusMinusInf);
    RUN_TEST(testDoublesGreaterThan);
    RUN_TEST(testDoublesGreaterThanInf);
    RUN_TEST(testDoublesNotGreaterThan);
    RUN_TEST(testDoublesNotGreaterThanNanActual);
    RUN_TEST(testDoublesNotGreaterThanNanThreshold);
    RUN_TEST(testDoublesNotGreaterThanNanBoth);
    RUN_TEST(testDoublesNotGreaterThanInfActual);
    RUN_TEST(testDoublesNotGreaterThanNegInf);
    RUN_TEST(testDoublesNotGreaterThanBothInf);
    RUN_TEST(testDoublesNotGreaterThanBothNegInf);
    RUN_TEST(testDoublesGreaterOrEqual);
    RUN_TEST(testDoublesGreaterOrEqualInf);
    RUN_TEST(testDoublesNotGreaterOrEqual);
    RUN_TEST(testDoublesNotGreaterOrEqualNanActual);
    RUN_TEST(testDoublesNotGreaterOrEqualNanThreshold);
    RUN_TEST(testDoublesGreaterOrEqualNanBoth);
    RUN_TEST(testDoublesNotGreaterOrEqualInfActual);
    RUN_TEST(testDoublesNotGreaterOrEqualNegInf);
    RUN_TEST(testDoublesGreaterOrEqualBothInf);
    RUN_TEST(testDoublesGreaterOrEqualBothNegInf);
    RUN_TEST(testDoublesLessThan);
    RUN_TEST(testDoublesLessThanInf);
    RUN_TEST(testDoublesNotLessThan);
    RUN_TEST(testDoublesNotLessThanNanActual);
    RUN_TEST(testDoublesNotLessThanNanThreshold);
    RUN_TEST(testDoublesNotLessThanNanBoth);
    RUN_TEST(testDoublesNotLessThanInf);
    RUN_TEST(testDoublesNotLessThanNegInf);
    RUN_TEST(testDoublesNotLessThanBothInf);
    RUN_TEST(testDoublesNotLessThanBothNegInf);
    RUN_TEST(testDoublesLessOrEqual);
    RUN_TEST(testDoublesLessOrEqualInf);
    RUN_TEST(testDoublesNotLessOrEqual);
    RUN_TEST(testDoublesNotLessOrEqualNanActual);
    RUN_TEST(testDoublesNotLessOrEqualNanThreshold);
    RUN_TEST(testDoublesLessOrEqualNanBoth);
    RUN_TEST(testDoublesNotLessOrEqualInf);
    RUN_TEST(testDoublesNotLessOrEqualNegInf);
    RUN_TEST(testDoublesLessOrEqualBothInf);
    RUN_TEST(testDoublesLessOrEqualBothNegInf);
    RUN_TEST(testDoubleIsPosInf1);
    RUN_TEST(testDoubleIsPosInf2);
    RUN_TEST(testDoubleIsNegInf1);
    RUN_TEST(testDoubleIsNegInf2);
    RUN_TEST(testDoubleIsNotPosInf1);
    RUN_TEST(testDoubleIsNotPosInf2);
    RUN_TEST(testDoubleIsNotNegInf);
    RUN_TEST(testDoubleIsNan1);
    RUN_TEST(testDoubleIsNan2);
    RUN_TEST(testDoubleIsNotNan1);
    RUN_TEST(testDoubleIsNotNan2);
    RUN_TEST(testDoubleInfIsNotNan);
    RUN_TEST(testDoubleNanIsNotInf);
    RUN_TEST(testDoubleIsDeterminate1);
    RUN_TEST(testDoubleIsDeterminate2);
    RUN_TEST(testDoubleIsNotDeterminate1);
    RUN_TEST(testDoubleIsNotDeterminate2);
    RUN_TEST(testDoubleTraitFailsOnInvalidTrait);
    RUN_TEST(testEqualDoubleArrays);
    RUN_TEST(testNotEqualDoubleArraysExpectedNull);
    RUN_TEST(testNotEqualDoubleArraysActualNull);
    RUN_TEST(testNotEqualDoubleArrays1);
    RUN_TEST(testNotEqualDoubleArrays2);
    RUN_TEST(testNotEqualDoubleArrays3);
    RUN_TEST(testNotEqualDoubleArraysNegative1);
    RUN_TEST(testNotEqualDoubleArraysNegative2);
    RUN_TEST(testNotEqualDoubleArraysNegative3);
    RUN_TEST(testEqualDoubleArraysNaN);
    RUN_TEST(testEqualDoubleArraysInf);
    RUN_TEST(testNotEqualDoubleArraysLengthZero);
    RUN_TEST(testDoubleArraysWithin);
    RUN_TEST(testDoubleArraysWithinUnusualDelta);
    RUN_TEST(testEqualDoubleEachEqual);
    RUN_TEST(testNotEqualDoubleEachEqualActualNull);
    RUN_TEST(testNotEqualDoubleEachEqual1);
    RUN_TEST(testNotEqualDoubleEachEqual2);
    RUN_TEST(testNotEqualDoubleEachEqual3);
    RUN_TEST(testNotEqualDoubleEachEqualNegative1);
    RUN_TEST(testNotEqualDoubleEachEqualNegative2);
    RUN_TEST(testNotEqualDoubleEachEqualNegative3);
    RUN_TEST(testEqualDoubleEachEqualNaN);
    RUN_TEST(testEqualDoubleEachEqualInf);
    RUN_TEST(testNotEqualDoubleEachEqualLengthZero);
    RUN_TEST(testDoublePrinting);
    RUN_TEST(testDoublePrintingRoundTiesToEven);
    RUN_TEST(testDoublePrintingInfinityAndNaN);
}

#endif
```

## src/run_test_unity_floats.c
```c
/*
 * Copyright 2024 NXP
 *
 * SPDX-License-Identifier: Apache-2.0
 */

#ifdef TEST_UNITY_FLOATS

#include "run_test_unity.h"
#include "test_unity_floats.c"

void run_test_unity_floats(void)
{
    RUN_TEST(testFloatsWithinDelta);
    RUN_TEST(testFloatsNotWithinDelta);
    RUN_TEST(testFloatsEqual);
    RUN_TEST(testFloatsNotEqual);
    RUN_TEST(testFloatsNotEqualNegative1);
    RUN_TEST(testFloatsNotEqualNegative2);
    RUN_TEST(testFloatsNotEqualActualNaN);
    RUN_TEST(testFloatsNotEqualExpectedNaN);
    RUN_TEST(testFloatsEqualBothNaN);
    RUN_TEST(testFloatsNotEqualInfNaN);
    RUN_TEST(testFloatsNotEqualNaNInf);
    RUN_TEST(testFloatsNotEqualActualInf);
    RUN_TEST(testFloatsNotEqualExpectedInf);
    RUN_TEST(testFloatsEqualBothInf);
    RUN_TEST(testFloatsNotEqualPlusMinusInf);
    RUN_TEST(testFloatsGreaterThan);
    RUN_TEST(testFloatsGreaterThanInf);
    RUN_TEST(testFloatsNotGreaterThan);
    RUN_TEST(testFloatsNotGreaterThanNanActual);
    RUN_TEST(testFloatsNotGreaterThanNanThreshold);
    RUN_TEST(testFloatsNotGreaterThanNanBoth);
    RUN_TEST(testFloatsNotGreaterThanInfActual);
    RUN_TEST(testFloatsNotGreaterThanNegInf);
    RUN_TEST(testFloatsNotGreaterThanBothInf);
    RUN_TEST(testFloatsNotGreaterThanBothNegInf);
    RUN_TEST(testFloatsGreaterOrEqual);
    RUN_TEST(testFloatsGreaterOrEqualInf);
    RUN_TEST(testFloatsNotGreaterOrEqual);
    RUN_TEST(testFloatsNotGreaterOrEqualNanActual);
    RUN_TEST(testFloatsNotGreaterOrEqualNanThreshold);
    RUN_TEST(testFloatsGreaterOrEqualNanBoth);
    RUN_TEST(testFloatsNotGreaterOrEqualInfActual);
    RUN_TEST(testFloatsNotGreaterOrEqualNegInf);
    RUN_TEST(testFloatsGreaterOrEqualBothInf);
    RUN_TEST(testFloatsGreaterOrEqualBothNegInf);
    RUN_TEST(testFloatsLessThan);
    RUN_TEST(testFloatsLessThanInf);
    RUN_TEST(testFloatsNotLessThan);
    RUN_TEST(testFloatsNotLessThanNanActual);
    RUN_TEST(testFloatsNotLessThanNanThreshold);
    RUN_TEST(testFloatsNotLessThanNanBoth);
    RUN_TEST(testFloatsNotLessThanInf);
    RUN_TEST(testFloatsNotLessThanNegInf);
    RUN_TEST(testFloatsNotLessThanBothInf);
    RUN_TEST(testFloatsNotLessThanBothNegInf);
    RUN_TEST(testFloatsLessOrEqual);
    RUN_TEST(testFloatsLessOrEqualInf);
    RUN_TEST(testFloatsNotLessOrEqual);
    RUN_TEST(testFloatsNotLessOrEqualNanActual);
    RUN_TEST(testFloatsNotLessOrEqualNanThreshold);
    RUN_TEST(testFloatsLessOrEqualNanBoth);
    RUN_TEST(testFloatsNotLessOrEqualInf);
    RUN_TEST(testFloatsNotLessOrEqualNegInf);
    RUN_TEST(testFloatsLessOrEqualBothInf);
    RUN_TEST(testFloatsLessOrEqualBothNegInf);
    RUN_TEST(testFloatIsPosInf1);
    RUN_TEST(testFloatIsPosInf2);
    RUN_TEST(testFloatIsNegInf1);
    RUN_TEST(testFloatIsNegInf2);
    RUN_TEST(testFloatIsNotPosInf1);
    RUN_TEST(testFloatIsNotPosInf2);
    RUN_TEST(testFloatIsNotNegInf);
    RUN_TEST(testFloatIsNan1);
    RUN_TEST(testFloatIsNan2);
    RUN_TEST(testFloatIsNotNan1);
    RUN_TEST(testFloatIsNotNan2);
    RUN_TEST(testFloatInfIsNotNan);
    RUN_TEST(testFloatNanIsNotInf);
    RUN_TEST(testFloatIsDeterminate1);
    RUN_TEST(testFloatIsDeterminate2);
    RUN_TEST(testFloatIsNotDeterminate1);
    RUN_TEST(testFloatIsNotDeterminate2);
    RUN_TEST(testFloatTraitFailsOnInvalidTrait);
    RUN_TEST(testEqualFloatArrays);
    RUN_TEST(testNotEqualFloatArraysExpectedNull);
    RUN_TEST(testNotEqualFloatArraysActualNull);
    RUN_TEST(testNotEqualFloatArrays1);
    RUN_TEST(testNotEqualFloatArrays2);
    RUN_TEST(testNotEqualFloatArrays3);
    RUN_TEST(testNotEqualFloatArraysNegative1);
    RUN_TEST(testNotEqualFloatArraysNegative2);
    RUN_TEST(testNotEqualFloatArraysNegative3);
    RUN_TEST(testEqualFloatArraysNaN);
    RUN_TEST(testEqualFloatArraysInf);
    RUN_TEST(testNotEqualFloatArraysLengthZero);
    RUN_TEST(testFloatArraysWithin);
    RUN_TEST(testFloatArraysWithinUnusualDelta);
    RUN_TEST(testEqualFloatEachEqual);
    RUN_TEST(testNotEqualFloatEachEqualActualNull);
    RUN_TEST(testNotEqualFloatEachEqual1);
    RUN_TEST(testNotEqualFloatEachEqual2);
    RUN_TEST(testNotEqualFloatEachEqual3);
    RUN_TEST(testNotEqualFloatEachEqualNegative1);
    RUN_TEST(testNotEqualFloatEachEqualNegative2);
    RUN_TEST(testNotEqualFloatEachEqualNegative3);
    RUN_TEST(testEqualFloatEachEqualNaN);
    RUN_TEST(testEqualFloatEachEqualInf);
    RUN_TEST(testNotEqualFloatEachEqualLengthZero);
    RUN_TEST(testFloatPrinting);
    RUN_TEST(testFloatPrintingRoundTiesToEven);
    RUN_TEST(testFloatPrintingInfinityAndNaN);
    RUN_TEST(testFloatPrintingRandomSamples);
}

#endif
```

## src/run_test_unity_integers.c
```c
/*
 * Copyright 2024 NXP
 *
 * SPDX-License-Identifier: Apache-2.0
 */

#ifdef TEST_UNITY_INTEGERS

#include "run_test_unity.h"
#include "test_unity_integers.c"

void run_test_unity_integers(void)
{
    RUN_TEST(testNotEqualInts);
    RUN_TEST(testNotEqualInt8s);
    RUN_TEST(testNotEqualChars);
    RUN_TEST(testNotEqualInt16s);
    RUN_TEST(testNotEqualInt32s);
    RUN_TEST(testNotEqualBits);
    RUN_TEST(testNotEqualUInts);
    RUN_TEST(testNotEqualUInt8s);
    RUN_TEST(testNotEqualUInt16s);
    RUN_TEST(testNotEqualUInt32s);
    RUN_TEST(testNotEqualHex8s);
    RUN_TEST(testNotEqualHex8sIfSigned);
    RUN_TEST(testNotEqualHex16s);
    RUN_TEST(testNotEqualHex16sIfSigned);
    RUN_TEST(testNotEqualHex32s);
    RUN_TEST(testNotEqualHex32sIfSigned);
    RUN_TEST(testEqualInts);
    RUN_TEST(testEqualInt8s);
    RUN_TEST(testEqualInt8sWhenThereAreDifferencesOutside8Bits);
    RUN_TEST(testEqualChars);
    RUN_TEST(testEqualCharsWhenThereAreDifferencesOutside8Bits);
    RUN_TEST(testEqualInt16s);
    RUN_TEST(testEqualInt16sNegatives);
    RUN_TEST(testEqualInt16sWhenThereAreDifferencesOutside16Bits);
    RUN_TEST(testEqualInt32s);
    RUN_TEST(testEqualInt32sNegatives);
    RUN_TEST(testEqualUints);
    RUN_TEST(testEqualUint8s);
    RUN_TEST(testEqualUint8sWhenThereAreDifferencesOutside8Bits);
    RUN_TEST(testEqualUint16s);
    RUN_TEST(testEqualUint16sWhenThereAreDifferencesOutside16Bits);
    RUN_TEST(testEqualUint32s);
    RUN_TEST(testNotEqual);
    RUN_TEST(testEqualHex8s);
    RUN_TEST(testEqualHex8sWhenThereAreDifferencesOutside8Bits);
    RUN_TEST(testEqualHex8sNegatives);
    RUN_TEST(testEqualHex16s);
    RUN_TEST(testEqualHex16sWhenThereAreDifferencesOutside16Bits);
    RUN_TEST(testEqualHex32s);
    RUN_TEST(testEqualBits);
    RUN_TEST(testNotEqualBitHigh);
    RUN_TEST(testNotEqualBitLow);
    RUN_TEST(testNotEqualBitsHigh);
    RUN_TEST(testNotEqualBitsLow);
    RUN_TEST(testEqualShorts);
    RUN_TEST(testEqualUShorts);
    RUN_TEST(testEqualUInts);
    RUN_TEST(testEqualUChars);
    RUN_TEST(testEqualPointers);
    RUN_TEST(testNotEqualPointers);
    RUN_TEST(testIntsWithinDelta);
    RUN_TEST(testIntsWithinDeltaAndCustomMessage);
    RUN_TEST(testIntsNotWithinDelta);
    RUN_TEST(testIntsNotWithinDeltaAndCustomMessage);
    RUN_TEST(testUIntsWithinDelta);
    RUN_TEST(testUIntsWithinDeltaAndCustomMessage);
    RUN_TEST(testUIntsNotWithinDelta);
    RUN_TEST(testUIntsNotWithinDeltaAndCustomMessage);
    RUN_TEST(testUIntsNotWithinDeltaEvenThoughASignedIntWouldPassSmallFirst);
    RUN_TEST(testUIntsNotWithinDeltaEvenThoughASignedIntWouldPassSmallFirstAndCustomMessage);
    RUN_TEST(testUIntsNotWithinDeltaEvenThoughASignedIntWouldPassBigFirst);
    RUN_TEST(testUIntsNotWithinDeltaEvenThoughASignedIntWouldPassBigFirstAndCustomMessage);
    RUN_TEST(testHEX32sWithinDelta);
    RUN_TEST(testHEX32sWithinDeltaShouldIgnoreSign);
    RUN_TEST(testHEX32sWithinDeltaAndCustomMessage);
    RUN_TEST(testHEX32sNotWithinDelta);
    RUN_TEST(testHEX32sNotWithinDeltaAndCustomMessage);
    RUN_TEST(testHEX32sNotWithinDeltaEvenThoughASignedIntWouldPass);
    RUN_TEST(testHEX32sNotWithinDeltaEvenThoughASignedIntWouldPassAndCustomMessage);
    RUN_TEST(testHEX16sWithinDelta);
    RUN_TEST(testHEX16sWithinDeltaShouldIgnoreSign);
    RUN_TEST(testHEX16sWithinDeltaAndCustomMessage);
    RUN_TEST(testHEX16sWithinDeltaWhenThereAreDifferenceOutsideOf16Bits);
    RUN_TEST(testHEX16sWithinDeltaWhenThereAreDifferenceOutsideOf16BitsAndCustomMessage);
    RUN_TEST(testHEX16sNotWithinDelta);
    RUN_TEST(testHEX16sNotWithinDeltaAndCustomMessage);
    RUN_TEST(testHEX8sWithinDelta);
    RUN_TEST(testHEX8sWithinDeltaShouldIgnoreSign);
    RUN_TEST(testHEX8sWithinDeltaAndCustomMessage);
    RUN_TEST(testHEX8sWithinDeltaWhenThereAreDifferenceOutsideOf8Bits);
    RUN_TEST(testHEX8sWithinDeltaWhenThereAreDifferenceOutsideOf8BitsAndCustomMessage);
    RUN_TEST(testHEX8sNotWithinDelta);
    RUN_TEST(testHEX8sNotWithinDeltaAndCustomMessage);
    RUN_TEST(testUINT32sWithinDelta);
    RUN_TEST(testUINT32sWithinDeltaAndCustomMessage);
    RUN_TEST(testUINT32sNotWithinDelta);
    RUN_TEST(testUINT32sNotWithinDeltaAndCustomMessage);
    RUN_TEST(testUINT32sNotWithinDeltaEvenThoughASignedIntWouldPass);
    RUN_TEST(testUINT32sNotWithinDeltaEvenThoughASignedIntWouldPassAndCustomMessage);
    RUN_TEST(testUINT16sWithinDelta);
    RUN_TEST(testUINT16sWithinDeltaAndCustomMessage);
    RUN_TEST(testUINT16sWithinDeltaWhenThereAreDifferenceOutsideOf16Bits);
    RUN_TEST(testUINT16sWithinDeltaWhenThereAreDifferenceOutsideOf16BitsAndCustomMessage);
    RUN_TEST(testUINT16sNotWithinDelta);
    RUN_TEST(testUINT16sNotWithinDeltaAndCustomMessage);
    RUN_TEST(testUINT8sWithinDelta);
    RUN_TEST(testUINT8sWithinDeltaAndCustomMessage);
    RUN_TEST(testUINT8sWithinDeltaWhenThereAreDifferenceOutsideOf8Bits);
    RUN_TEST(testUINT8sWithinDeltaWhenThereAreDifferenceOutsideOf8BitsAndCustomMessage);
    RUN_TEST(testUINT8sNotWithinDelta);
    RUN_TEST(testUINT8sNotWithinDeltaAndCustomMessage);
    RUN_TEST(testINT32sWithinDelta);
    RUN_TEST(testINT32sWithinDeltaAndCustomMessage);
    RUN_TEST(testINT32sNotWithinDelta);
    RUN_TEST(testINT32sNotWithinDeltaAndDifferenceOverflows);
    RUN_TEST(testINT32sNotWithinDeltaAndCustomMessage);
    RUN_TEST(testINT16sWithinDelta);
    RUN_TEST(testINT16sWithinDeltaAndCustomMessage);
    RUN_TEST(testINT16sWithinDeltaWhenThereAreDifferenceOutsideOf16Bits);
    RUN_TEST(testINT16sWithinDeltaWhenThereAreDifferenceOutsideOf16BitsAndCustomMessage);
    RUN_TEST(testINT16sNotWithinDelta);
    RUN_TEST(testINT16sNotWithinDeltaAndCustomMessage);
    RUN_TEST(testINT8sWithinDelta);
    RUN_TEST(testINT8sWithinDeltaAndCustomMessage);
    RUN_TEST(testINT8sWithinDeltaWhenThereAreDifferenceOutsideOf8Bits);
    RUN_TEST(testINT8sWithinDeltaWhenThereAreDifferenceOutsideOf8BitsAndCustomMessage);
    RUN_TEST(testINT8sNotWithinDelta);
    RUN_TEST(testINT8sNotWithinDeltaAndCustomMessage);
    RUN_TEST(testCHARsWithinDelta);
    RUN_TEST(testCHARsWithinDeltaAndCustomMessage);
    RUN_TEST(testCHARsWithinDeltaWhenThereAreDifferenceOutsideOf8Bits);
    RUN_TEST(testCHARsWithinDeltaWhenThereAreDifferenceOutsideOf8BitsAndCustomMessage);
    RUN_TEST(testCHARsNotWithinDelta);
    RUN_TEST(testCHARsNotWithinDeltaAndCustomMessage);
    RUN_TEST(testNotEqualINT);
    RUN_TEST(testNotNotEqualINT);
    RUN_TEST(testNotEqualINT8);
    RUN_TEST(testNotNotEqualINT8);
    RUN_TEST(testNotEqualCHAR);
    RUN_TEST(testNotNotEqualCHAR);
    RUN_TEST(testNotEqualINT16);
    RUN_TEST(testNotNotEqualINT16);
    RUN_TEST(testNotEqualINT32);
    RUN_TEST(testNotNotEqualINT32);
    RUN_TEST(testNotEqualUINT);
    RUN_TEST(testNotNotEqualUINT);
    RUN_TEST(testNotEqualUINT8);
    RUN_TEST(testNotNotEqualUINT8);
    RUN_TEST(testNotEqualUINT16);
    RUN_TEST(testNotNotEqualUINT16);
    RUN_TEST(testNotEqualUINT32);
    RUN_TEST(testNotNotEqualUINT32);
    RUN_TEST(testNotEqualHEX8);
    RUN_TEST(testNotNotEqualHEX8);
    RUN_TEST(testNotEqualHEX16);
    RUN_TEST(testNotNotEqualHEX16);
    RUN_TEST(testNotEqualHEX32);
    RUN_TEST(testNotNotEqualHEX32);
    RUN_TEST(testGreaterThan);
    RUN_TEST(testNotGreaterThan);
    RUN_TEST(testGreaterThanINT);
    RUN_TEST(testNotGreaterThanINT);
    RUN_TEST(testGreaterThanINT8);
    RUN_TEST(testNotGreaterThanINT8);
    RUN_TEST(testGreaterThanCHAR);
    RUN_TEST(testNotGreaterThanCHAR);
    RUN_TEST(testGreaterThanINT16);
    RUN_TEST(testNotGreaterThanINT16);
    RUN_TEST(testGreaterThanINT32);
    RUN_TEST(testNotGreaterThanINT32);
    RUN_TEST(testGreaterThanUINT);
    RUN_TEST(testNotGreaterThanUINT);
    RUN_TEST(testGreaterThanUINT8);
    RUN_TEST(testNotGreaterThanUINT8);
    RUN_TEST(testGreaterThanUINT16);
    RUN_TEST(testNotGreaterThanUINT16);
    RUN_TEST(testGreaterThanUINT32);
    RUN_TEST(testNotGreaterThanUINT32);
    RUN_TEST(testGreaterThanHEX8);
    RUN_TEST(testNotGreaterThanHEX8);
    RUN_TEST(testGreaterThanHEX16);
    RUN_TEST(testNotGreaterThanHEX16);
    RUN_TEST(testGreaterThanHEX32);
    RUN_TEST(testNotGreaterThanHEX32);
    RUN_TEST(testGreaterOrEqual);
    RUN_TEST(testNotGreaterOrEqual);
    RUN_TEST(testGreaterOrEqualINT);
    RUN_TEST(testNotGreaterOrEqualINT);
    RUN_TEST(testGreaterOrEqualINT8);
    RUN_TEST(testNotGreaterOrEqualINT8);
    RUN_TEST(testGreaterOrEqualCHAR);
    RUN_TEST(testNotGreaterOrEqualCHAR);
    RUN_TEST(testGreaterOrEqualINT16);
    RUN_TEST(testNotGreaterOrEqualINT16);
    RUN_TEST(testGreaterOrEqualINT32);
    RUN_TEST(testNotGreaterOrEqualINT32);
    RUN_TEST(testGreaterOrEqualUINT);
    RUN_TEST(testNotGreaterOrEqualUINT);
    RUN_TEST(testGreaterOrEqualUINT8);
    RUN_TEST(testNotGreaterOrEqualUINT8);
    RUN_TEST(testGreaterOrEqualUINT16);
    RUN_TEST(testNotGreaterOrEqualUINT16);
    RUN_TEST(testGreaterOrEqualUINT32);
    RUN_TEST(testNotGreaterOrEqualUINT32);
    RUN_TEST(testGreaterOrEqualHEX8);
    RUN_TEST(testNotGreaterOrEqualHEX8);
    RUN_TEST(testGreaterOrEqualHEX16);
    RUN_TEST(testNotGreaterOrEqualHEX16);
    RUN_TEST(testGreaterOrEqualHEX32);
    RUN_TEST(testNotGreaterOrEqualHEX32);
    RUN_TEST(testLessThan);
    RUN_TEST(testNotLessThan);
    RUN_TEST(testLessThanINT);
    RUN_TEST(testNotLessThanINT);
    RUN_TEST(testLessThanINT8);
    RUN_TEST(testNotLessThanINT8);
    RUN_TEST(testLessThanCHAR);
    RUN_TEST(testNotLessThanCHAR);
    RUN_TEST(testLessThanINT16);
    RUN_TEST(testNotLessThanINT16);
    RUN_TEST(testLessThanINT32);
    RUN_TEST(testNotLessThanINT32);
    RUN_TEST(testLessThanUINT);
    RUN_TEST(testNotLessThanUINT);
    RUN_TEST(testLessThanUINT8);
    RUN_TEST(testNotLessThanUINT8);
    RUN_TEST(testLessThanUINT16);
    RUN_TEST(testNotLessThanUINT16);
    RUN_TEST(testLessThanUINT32);
    RUN_TEST(testNotLessThanUINT32);
    RUN_TEST(testLessThanHEX8);
    RUN_TEST(testNotLessThanHEX8);
    RUN_TEST(testLessThanHEX16);
    RUN_TEST(testNotLessThanHEX16);
    RUN_TEST(testLessThanHEX32);
    RUN_TEST(testNotLessThanHEX32);
    RUN_TEST(testLessOrEqual);
    RUN_TEST(testNotLessOrEqual);
    RUN_TEST(testLessOrEqualINT);
    RUN_TEST(testNotLessOrEqualINT);
    RUN_TEST(testLessOrEqualINT8);
    RUN_TEST(testNotLessOrEqualINT8);
    RUN_TEST(testLessOrEqualCHAR);
    RUN_TEST(testNotLessOrEqualCHAR);
    RUN_TEST(testLessOrEqualINT16);
    RUN_TEST(testNotLessOrEqualINT16);
    RUN_TEST(testLessOrEqualINT32);
    RUN_TEST(testNotLessOrEqualINT32);
    RUN_TEST(testLessOrEqualUINT);
    RUN_TEST(testNotLessOrEqualUINT);
    RUN_TEST(testLessOrEqualUINT8);
    RUN_TEST(testNotLessOrEqualUINT8);
    RUN_TEST(testLessOrEqualUINT16);
    RUN_TEST(testNotLessOrEqualUINT16);
    RUN_TEST(testLessOrEqualUINT32);
    RUN_TEST(testNotLessOrEqualUINT32);
    RUN_TEST(testLessOrEqualHEX8);
    RUN_TEST(testNotLessOrEqualHEX8);
    RUN_TEST(testLessOrEqualHEX16);
    RUN_TEST(testNotLessOrEqualHEX16);
    RUN_TEST(testLessOrEqualHEX32);
    RUN_TEST(testNotLessOrEqualHEX32);
    RUN_TEST(testHexPrintsUpToMaxNumberOfNibbles);
    RUN_TEST(testPrintNumbers32);
    RUN_TEST(testPrintNumbersUnsigned32);
}

#endif
```

## src/run_test_unity_integers_64.c
```c
/*
 * Copyright 2024 NXP
 *
 * SPDX-License-Identifier: Apache-2.0
 */

#ifdef TEST_UNITY_INTEGERS_64

#include "run_test_unity.h"
#include "test_unity_integers_64.c"

void run_test_unity_integers_64(void)
{
    RUN_TEST(testInt64ArrayWithinDelta);
    RUN_TEST(testInt64ArrayWithinDeltaAndMessage);
    RUN_TEST(testInt64ArrayNotWithinDelta);
    RUN_TEST(testInt64ArrayNotWithinDeltaAndMessage);
    RUN_TEST(testInt64ArrayWithinDeltaPointless);
    RUN_TEST(testInt64ArrayWithinDeltaPointlessAndMessage);
    RUN_TEST(testInt64ArrayWithinDeltaExpectedNull);
    RUN_TEST(testInt64ArrayWithinDeltaExpectedNullAndMessage);
    RUN_TEST(testInt64ArrayWithinDeltaActualNull);
    RUN_TEST(testInt64ArrayWithinDeltaActualNullAndMessage);
    RUN_TEST(testInt64ArrayWithinDeltaSamePointer);
    RUN_TEST(testInt64ArrayWithinDeltaSamePointerAndMessage);
    RUN_TEST(testUInt64ArrayWithinDelta);
    RUN_TEST(testUInt64ArrayWithinDeltaAndMessage);
    RUN_TEST(testUInt64ArrayNotWithinDelta);
    RUN_TEST(testUInt64ArrayNotWithinDeltaAndMessage);
    RUN_TEST(testUInt64ArrayWithinDeltaPointless);
    RUN_TEST(testUInt64ArrayWithinDeltaPointlessAndMessage);
    RUN_TEST(testUInt64ArrayWithinDeltaExpectedNull);
    RUN_TEST(testUInt64ArrayWithinDeltaExpectedNullAndMessage);
    RUN_TEST(testUInt64ArrayWithinDeltaActualNull);
    RUN_TEST(testUInt64ArrayWithinDeltaActualNullAndMessage);
    RUN_TEST(testUInt64ArrayWithinDeltaSamePointer);
    RUN_TEST(testUInt64ArrayWithinDeltaSamePointerAndMessage);
    RUN_TEST(testHEX64ArrayWithinDelta);
    RUN_TEST(testHEX64ArrayWithinDeltaAndMessage);
    RUN_TEST(testHEX64ArrayNotWithinDelta);
    RUN_TEST(testHEX64ArrayNotWithinDeltaAndMessage);
    RUN_TEST(testHEX64ArrayWithinDeltaPointless);
    RUN_TEST(testHEX64ArrayWithinDeltaPointlessAndMessage);
    RUN_TEST(testHEX64ArrayWithinDeltaExpectedNull);
    RUN_TEST(testHEX64ArrayWithinDeltaExpectedNullAndMessage);
    RUN_TEST(testHEX64ArrayWithinDeltaActualNull);
    RUN_TEST(testHEX64ArrayWithinDeltaActualNullAndMessage);
    RUN_TEST(testHEX64ArrayWithinDeltaSamePointer);
    RUN_TEST(testHEX64ArrayWithinDeltaSamePointerAndMessage);
    RUN_TEST(testEqualHex64s);
    RUN_TEST(testEqualUint64s);
    RUN_TEST(testEqualInt64s);
    RUN_TEST(testNotEqualHex64s);
    RUN_TEST(testNotEqualUint64s);
    RUN_TEST(testNotEqualInt64s);
    RUN_TEST(testNotEqualHex64sIfSigned);
    RUN_TEST(testHEX64sWithinDelta);
    RUN_TEST(testHEX32sWithinDeltaShouldIgnoreSign);
    RUN_TEST(testHEX64sNotWithinDelta);
    RUN_TEST(testHEX64sNotWithinDeltaEvenThoughASignedIntWouldPass);
    RUN_TEST(testUINT64sWithinDelta);
    RUN_TEST(testUINT64sNotWithinDelta);
    RUN_TEST(testUINT64sNotWithinDeltaEvenThoughASignedIntWouldPass);
    RUN_TEST(testINT64sWithinDelta);
    RUN_TEST(testINT64sNotWithinDelta);
    RUN_TEST(testINT64sNotWithinDeltaAndDifferenceOverflows);
    RUN_TEST(testPrintNumbersInt64);
    RUN_TEST(testPrintNumbersUInt64);
}

#endif
```

## src/run_test_unity_parameterized.c
```c
/*
 * Copyright 2024 NXP
 *
 * SPDX-License-Identifier: Apache-2.0
 */

#ifdef TEST_UNITY_PARAMETERIZED

#include "run_test_unity.h"
#include "test_unity_parameterized.c"

void run_test_unity_parameterized(void)
{
    // TODO
}

#endif
```

## src/run_test_unity_parameterizedDemo.c
```c
/*
 * Copyright 2024 NXP
 *
 * SPDX-License-Identifier: Apache-2.0
 */

#ifdef TEST_UNITY_PARAMETERIZEDDEMO

#include "run_test_unity.h"
#include "test_unity_parameterizedDemo.c"

void run_test_unity_parameterizedDemo(void)
{
    // TODO
}

#endif
```
