## Kconfig
```kconfig
config UNITY_TEST
    bool "Enable Unity Test framework"
    default n
    help
      Enable this option to use the Unity Test framework in your project.
```

## tests/test_unity/testcase.yaml
```yaml
tests:
  test_unity.arrays:
    build_only: false
    extra_args: TEST_UNITY_ARRAYS=TRUE
    tags: unity test_unity test_unity_arrays

  test_unity.core:
    build_only: false
    extra_args: TEST_UNITY_CORE=TRUE
    tags: unity test_unity test_unity_core

  test_unity.doubles:
    build_only: false
    extra_args: TEST_UNITY_DOUBLES=TRUE
    tags: unity test_unity test_unity_doubles

  test_unity.floats:
    build_only: false
    extra_args: TEST_UNITY_FLOATS=TRUE
    tags: unity test_unity test_unity_floats

  test_unity.integers:
    build_only: false
    extra_args: TEST_UNITY_INTEGERS=TRUE
    tags: unity test_unity test_unity_integers

  test_unity.integers_64:
    build_only: false
    extra_args: TEST_UNITY_INTEGERS_64=TRUE
    tags: unity test_unity test_unity_integers_64

  test_unity.memory:
    build_only: false
    extra_args: TEST_UNITY_MEMORY=TRUE
    tags: unity test_unity test_unity_memory

  test_unity.parameterized:
    build_only: false
    extra_args: TEST_UNITY_PARAMETERIZED=TRUE
    tags: unity test_unity test_unity_parameterized

  test_unity.parameterizedDemo:
    build_only: false
    extra_args: TEST_UNITY_PARAMETERIZEDDEMO=TRUE
    tags: unity test_unity test_unity_parametereizedDemo

  test_unity.strings:
    build_only: false
    extra_args: TEST_UNITY_STRINGS=TRUE
    tags: unity test_unity test_unity_strings
```

## west.yml
```yaml
manifest:
  self:
    path: modules/importunity

  projects:
    - name: unity
    description: Unity Test framework
    url: https://github.com/ThrowTheSwitch/Unity.git
    revision: v2.6.0
    path: modules/unity
```
